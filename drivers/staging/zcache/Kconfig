## drivers/staging/zcache/Kconfig
```kconfig
config ZCACHE
	bool "Dynamic compression of swap pages and clean pagecache pages"
	depends on (CLEANCACHE || FRONTSWAP) && CRYPTO=y && ZSMALLOC=y
	default n
	help
	  Zcache doubles RAM efficiency while providing a significant
	  performance boosts on many workloads.  Zcache uses
	  compression and an in-kernel implementation of transcendent
	  memory to store clean page cache pages and swap in RAM,
	  providing a noticeable reduction in disk I/O.

choice
	prompt "Zcache crypto compression method"
	depends on ZCACHE
	default ZCACHE_CRYPTO_LZO
	help
	  Select the crypto compression method used by zcache.
	  LZO is the default. Snappy compresses a bit worse (around ~2%) but
	  much (~2x) faster, at least on x86-64.
config ZCACHE_CRYPTO_LZO
	bool "LZO crypto compression"
	select CRYPTO_LZO
config ZCACHE_CRYPTO_SNAPPY
	bool "Snappy crypto compression"
	select CRYPTO_SNAPPY
endchoice
```
